## release/src-rt-5.02hnd/bcmdrivers/broadcom/char/pon_drv/Kconfig.autodetect
```kconfig
config BCM_PON_DRV
	tristate "Support for Broadcom Pon Drv features"
	default m if BCM96858
	default n

config BCM_PON_DRV_IMPL
	int "Implementation index for Broadcom Pon Drv features"
	depends on BCM_PON_DRV
	default 1
```
